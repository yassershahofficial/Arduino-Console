#include "U8glib.h"
U8GLIB_SSD1306_128X64 u8g(U8G_I2C_OPT_NONE|U8G_I2C_OPT_DEV_0);
const unsigned char border [] PROGMEM = {
  0x1f, 0xff, 0xff, 0xff, 0xff, 0xff, 0xff, 0xfc, 0x1f, 0xff, 0xff, 0xff, 0xff, 0xff, 0xff, 0xfc, 
  0xf0, 0x00, 0x00, 0x00, 0x00, 0x00, 0x00, 0x03, 0xe0, 0x00, 0x00, 0x00, 0x00, 0x00, 0x00, 0x01, 
  0xc0, 0x00, 0x00, 0x00, 0x00, 0x00, 0x00, 0x01, 0xc0, 0x00, 0x00, 0x00, 0x00, 0x00, 0x00, 0x01, 
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  0xff, 0xff, 0xff, 0xff, 0xff, 0xff, 0xff, 0xfb, 0x1f, 0xff, 0xff, 0xff, 0xff, 0xff, 0xff, 0xfc
};
const unsigned char dinoIcons [] PROGMEM = {
  0x00, 0x00, 0x00, 0x00, 0x00, 0x00, 0x00, 0x00, 0x00, 0x00, 0x00, 0x00, 0x00, 0x00, 0x00, 0x00, 
  0x00, 0x00, 0x00, 0x00, 0x00, 0x00, 0x00, 0x00, 0x00, 0x00, 0x00, 0x00, 0x00, 0x00, 0x00, 0x00, 
  0x00, 0x00, 0x00, 0x00, 0x00, 0x00, 0x00, 0x00, 0x00, 0x00, 0x00, 0x00, 0x3f, 0xf8, 0x00, 0x00, 
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  0x00, 0x00, 0x00, 0x00, 0x00, 0x00, 0x00, 0x00, 0x00, 0x00, 0x00, 0x00, 0x00, 0x00, 0x00, 0x00
};
const unsigned char pongIcons [] PROGMEM = {
  0x00, 0x00, 0x00, 0x00, 0x00, 0x00, 0x00, 0x00, 0x00, 0x00, 0x00, 0x00, 0x00, 0x00, 0x00, 0x00, 
  0x00, 0x00, 0x00, 0x00, 0x00, 0x00, 0x00, 0x00, 0x00, 0x00, 0x00, 0x00, 0x00, 0x00, 0x00, 0x00, 
  0x00, 0x00, 0x00, 0x00, 0xff, 0xf8, 0x00, 0x00, 0x00, 0x00, 0x1f, 0x03, 0x80, 0x07, 0x00, 0x00, 
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  0x00, 0x00, 0x00, 0x00, 0x00, 0x00, 0x00, 0x00, 0x00, 0x00, 0x00, 0x00, 0x00, 0x00, 0x00, 0x00
};
const unsigned char fpsIcons [] PROGMEM = {
  0x00, 0x00, 0x00, 0x00, 0x00, 0x00, 0x00, 0x00, 0x00, 0x00, 0x00, 0x00, 0x00, 0x00, 0x00, 0x00, 
  0x00, 0x00, 0x00, 0x00, 0x00, 0x00, 0x00, 0x00, 0x00, 0x00, 0x00, 0x00, 0x00, 0x00, 0x00, 0x00, 
  0x00, 0x00, 0x00, 0x00, 0x00, 0x00, 0x00, 0x00, 0x00, 0x00, 0x00, 0x00, 0x00, 0x00, 0x00, 0x00, 
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  0x00, 0x00, 0x00, 0x00, 0x00, 0x00, 0x00, 0x00, 0x00, 0x00, 0x00, 0x00, 0x00, 0x00, 0x00, 0x00
};

//Movement Push Button Pins
#define btnUp_pin 4
#define btnDown_pin 2
#define btnActA_pin 13
#define btnActB_pin 12

//Buttons Press Detection
#define ledPower_pin 7
bool pressed = false;

const int homeLen = 3;
const unsigned char* homeIcons[3] = {
  pongIcons,
  dinoIcons,
  fpsIcons
};

int currentItem = 0;
int previousItem;
int nextItem;
void draw(void) {
  u8g.drawBitmapP( 0, 0, 64/8, 64, homeIcons[currentItem]);
  u8g.drawBitmapP( 64, 0, 64/8, 64, homeIcons[nextItem]);
  u8g.drawBitmapP( 0, 0, 64/8, 64, border);
}
void homeStatus(void){
  previousItem = currentItem - 1;
  if(previousItem < 0 ){
    previousItem = homeLen - 1;
  }
  nextItem = currentItem + 1;
  if(nextItem >= homeLen){
    nextItem = 0;
  }
}
void key(){
  bool btnUp = digitalRead(btnUp_pin);
  bool btnDown = digitalRead(btnDown_pin);
  bool btnActA = digitalRead(btnActA_pin);
  bool btnActB = digitalRead(btnActB_pin);

  if(btnUp == pressed){
    digitalWrite(ledPower_pin,1);
    if(currentItem >= homeLen - 1){
      currentItem = 0;
    }
    else{
      currentItem++;
    }
    while(!digitalRead(btnUp_pin)){
      //while still pressed, do nothing
    }
  }
  else if(btnDown == pressed){
    digitalWrite(ledPower_pin,1);
    if(currentItem <= 0){
      currentItem = homeLen - 1;
    }
    else{
      currentItem--;
    }
    while(!digitalRead(btnDown)){
      //while still pressed, do nothing
    }
  }
  else if(btnActA == pressed){
    digitalWrite(ledPower_pin,1);
    while(!digitalRead(btnActA)){
      //while still pressed, do nothing
    }
  }
  else if(btnActB == pressed){
    digitalWrite(ledPower_pin,1);
    while(!digitalRead(btnActB)){
      //while still pressed, do nothing
    }
  }
  else{
    digitalWrite(ledPower_pin,0);
  }
}
void setup(void) {
  //Initialize Mov Pins
  pinMode(btnUp_pin, INPUT_PULLUP);
  pinMode(btnDown_pin, INPUT_PULLUP);
  pinMode(btnActA_pin, INPUT_PULLUP);
  pinMode(btnActB_pin, INPUT_PULLUP);
  
  pinMode(ledPower_pin, OUTPUT);
}

void loop(void) {
  u8g.firstPage();  
  homeStatus();
  do {
    key();
    draw();
  } while( u8g.nextPage() );
  
  // rebuild the picture after some delay
  //delay(50);
}
