#include "U8glib.h"
U8GLIB_SSD1306_128X64 u8g(U8G_I2C_OPT_NONE|U8G_I2C_OPT_DEV_0);
// 'FSdino', 128x64px
const unsigned char FSdino [] PROGMEM = {
  0x00, 0x00, 0x00, 0x00, 0xff, 0xff, 0xff, 0xff, 0xff, 0xff, 0xff, 0xff, 0x00, 0x00, 0x00, 0x00, 
  0x00, 0x00, 0x00, 0x00, 0x7f, 0xff, 0xff, 0xff, 0xff, 0xff, 0xff, 0xfe, 0x00, 0x00, 0x00, 0x00, 
  0x00, 0x00, 0x00, 0x00, 0x3f, 0xff, 0xe0, 0x33, 0x98, 0x0f, 0xff, 0xfc, 0x00, 0x00, 0x00, 0x00, 
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  0x00, 0x00, 0x00, 0x00, 0x00, 0x00, 0x00, 0x00, 0x00, 0x00, 0x00, 0x00, 0x00, 0x00, 0x00, 0x00
};
// 'FSfps', 128x64px
const unsigned char FSfps [] PROGMEM = {
  0x00, 0x00, 0x00, 0x00, 0xff, 0xff, 0xff, 0xff, 0xff, 0xff, 0xff, 0xff, 0x00, 0x00, 0x00, 0x00, 
  0x00, 0x00, 0x00, 0x00, 0x7f, 0xff, 0xff, 0xff, 0xff, 0xff, 0xff, 0xfe, 0x00, 0x00, 0x00, 0x00, 
  0x00, 0x00, 0x00, 0x00, 0x3f, 0xff, 0xe0, 0x33, 0x98, 0x0f, 0xff, 0xfc, 0x00, 0x00, 0x00, 0x00, 
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  0x00, 0x00, 0x00, 0x00, 0x00, 0x00, 0x00, 0x00, 0x00, 0x00, 0x00, 0x00, 0x00, 0x00, 0x00, 0x00
};
// 'FSpong', 128x64px
const unsigned char FSpong [] PROGMEM = {
  0x00, 0x00, 0x00, 0x00, 0xff, 0xff, 0xff, 0xff, 0xff, 0xff, 0xff, 0xff, 0x00, 0x00, 0x00, 0x00, 
  0x00, 0x00, 0x00, 0x00, 0x7f, 0xff, 0xff, 0xff, 0xff, 0xff, 0xff, 0xfe, 0x00, 0x00, 0x00, 0x00, 
  0x00, 0x00, 0x00, 0x00, 0x3f, 0xff, 0xe0, 0x33, 0x98, 0x0f, 0xff, 0xfc, 0x00, 0x00, 0x00, 0x00, 
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  0x00, 0x00, 0x00, 0x00, 0x00, 0x00, 0x00, 0x00, 0x00, 0x00, 0x00, 0x00, 0x00, 0x00, 0x00, 0x00
};

// Array of all bitmaps for convenience. (Total bytes used to store images in PROGMEM = 3120)
const int homeLen = 3;
const unsigned char* homeIcons[3] = {
  FSdino,
  FSpong,
  FSfps
};

//Movement Push Button Pins
#define btnUp_pin 4
#define btnDown_pin 2
#define btnActA_pin 13
#define btnActB_pin 12

//Buttons Press Detection
#define ledPower_pin 7
bool pressed = false;
int isPressedActA, isPressedActB, isPressedDown, isPressedUp = 0;
int currentItem = 0;

//Phase Management
int phase = 9;
 
void draw(void) {
  u8g.drawBitmapP( 0, 0, 128/8, 64, homeIcons[currentItem]);
};
void drawDino(void) {
  u8g.drawFrame(10,12,30,20);
};
void drawPong(void) {
  u8g.drawCircle(20, 20, 14);
};
void drawFps(void) {
  u8g.drawLine(7, 10, 40, 55);
};
void key(){
  bool btnUp = digitalRead(btnUp_pin);
  bool btnDown = digitalRead(btnDown_pin);
  bool btnActA = digitalRead(btnActA_pin);
  bool btnActB = digitalRead(btnActB_pin);

  if(btnUp == pressed){
    digitalWrite(ledPower_pin,1);
    if(isPressedUp == 0){
      if(currentItem >= homeLen - 1){
        currentItem = 0;
      }
      else{
        currentItem++;
      }
    }
    while(!digitalRead(btnUp)){
    }
    isPressedUp = 1;
  }
  else if(btnDown == pressed){
    digitalWrite(ledPower_pin,1);
    if(isPressedDown == 0){
      if(currentItem <= 0){
        currentItem = homeLen - 1;
      }
      else{
        currentItem--;
      }
    }
    while(!digitalRead(btnDown)){
    }
    isPressedDown = 1;
  }
  else if(btnActA == pressed){
    digitalWrite(ledPower_pin,1);
    if(isPressedActA == 0){
    }
    while(!digitalRead(btnActA)){
      //while still pressed, do nothing
    }
    isPressedActA = 1;
  }
  else if(btnActB == pressed){
    digitalWrite(ledPower_pin,1);
    if(isPressedActB == 0){
      phase = currentItem;
    }
    while(!digitalRead(btnActB)){
      //while still pressed, do nothing
    }
    isPressedActB = 1;
  }
  else{
    digitalWrite(ledPower_pin,0);
    isPressedDown = 0;
    isPressedActA = 0;
    isPressedActB = 0;
    isPressedUp = 0;
  }
}
void keyOther(){
  bool btnUp = digitalRead(btnUp_pin);
  bool btnDown = digitalRead(btnDown_pin);
  bool btnActA = digitalRead(btnActA_pin);
  bool btnActB = digitalRead(btnActB_pin);

  if(btnUp == pressed){
    digitalWrite(ledPower_pin,1);
    if(isPressedUp == 0){
    }
    while(!digitalRead(btnUp)){
    }
    isPressedUp = 1;
  }
  else if(btnDown == pressed){
    digitalWrite(ledPower_pin,1);
    if(isPressedDown == 0){
    }
    while(!digitalRead(btnDown)){
    }
    isPressedDown = 1;
  }
  else if(btnActA == pressed){
    digitalWrite(ledPower_pin,1);
    if(isPressedActA == 0){
      phase = 9;
    }
    while(!digitalRead(btnActA)){
      //while still pressed, do nothing
    }
    isPressedActA = 1;
  }
  else if(btnActB == pressed){
    digitalWrite(ledPower_pin,1);
    if(isPressedActB == 0){
    }
    while(!digitalRead(btnActB)){
      //while still pressed, do nothing
    }
    isPressedActB = 1;
  }
  else{
    digitalWrite(ledPower_pin,0);
    isPressedDown = 0;
    isPressedActA = 0;
    isPressedActB = 0;
    isPressedUp = 0;
  }
}
void setup(void) {
  //Initialize Mov Pins
  pinMode(btnUp_pin, INPUT_PULLUP);
  pinMode(btnDown_pin, INPUT_PULLUP);
  pinMode(btnActA_pin, INPUT_PULLUP);
  pinMode(btnActB_pin, INPUT_PULLUP);
  
  pinMode(ledPower_pin, OUTPUT);
}

void loop(void) {
  u8g.firstPage();  
  do {
    switch(phase){
      case 0:
        drawDino();
        keyOther();
        break;
      case 1:
        drawFps();
        keyOther();
        break;
      case 2:
        drawPong();
        keyOther();
        break;
      default:
        draw();
        key();
        break;
    }
  } while( u8g.nextPage() );
}
